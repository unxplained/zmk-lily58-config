## config/west.yml
```yaml
manifest:
  remotes:
    - name: zmkfirmware
      url-base: https://github.com/zmkfirmware
    - name: pete
      url-base: https://github.com/petejohanson
    - name: megamind
      url-base: https://github.com/megamind4089
  projects:
    - name: zmk
      remote: pete
      revision: sensors/encoder-inc-dec-handle-more-ticks
      import: app/west.yml
  self:
    path: config
```
